## arch/arm/hotplug/Kconfig
```kconfig
config MSM_HOTPLUG
	bool "MSM hotplug driver"
	depends on HOTPLUG_CPU
	default y
	help
	  The MSM hotplug driver controls on-/offlining of additional cores based
	  on current cpu load.

config BRICKED_HOTPLUG
	bool "Enable kernel based mpdecision"
	depends on MSM_RUN_QUEUE_STATS
	default n
	help
	  This enables kernel based multi core control.
	  (up/down hotplug based on load)

config ZEN_DECISION
	bool "Zen Decision: MSM Userspace Handler"
	depends on SMP && FB
	default n
	help
	  MSM/Qcomm devices have multiple userspace applications that handle
	  CPU hotplugging and frequency operations.

	  ZenDecision is a "handler" to account for behavior caused by
	  disabling some of these services.

	  For example, If MPDecision is disabled and MSM-Thermal_Engine is 
	  enabled in the userspace. Situations where CPUs go offline but never
	  come back online occur. ZenDecision handles the situation of CPUs
	  never coming online when they are supposed.
  
	  ZenDecision ensures all CPUs are online when they are supposed to be by:
	  - Enable all CPUs when screen comes on after wake_wait_delay
	  - Ignore all CPU_UP operations when battery level is <= 15% to respect
	    decisions of MSMThermal.

	  Userspace tunables for ZenDecision (/sys/kernel/zen_decision):
	  - enabled (0 or 1): Enable or disable the driver.
	  - wake_wait_time (0-60000): How long to wait before executing CPU_UP work.
	  - bat_threshold_ignore (0-100, 0=disabled): Don't do any CPU_UP work up to
	     this battery charge level.

	  WARNING: ZenDecision is not a direct replacement for any of the MSM userspace
	  services. It is simply designed to "handle" specific behaviors that are caused
	  by disabling these services.

	  If unsure, say N.
	  
config MAKO_HOTPLUG
        bool "Enable mako-hotplug cpu hotplug driver"
        default n
        help
          Generic Intelli-plug cpu hotplug driver for ARM SOCs	  

config BLU_PLUG
	bool "Dynamic hotplug driver"
	depends on HOTPLUG_CPU
	default n
	help
	  The Dynamic hotplug driver automatically online/offline CPUs proportional to system load.
	    
config FAST_HOTPLUG
	bool "Enable fast hotplug"
	default n
	help
	  Kernel based core control.
	  
config THUNDERPLUG_CONTROL
      bool "Enable plugging down/up of cores using powersuspend"
      help
       This driver uses powersuspend to take down the cpu cores
       on a octa core device. Tuned to work on a quad core device.
```

## arch/arm64/hotplug/AIO_PLUG/Kconfig
```kconfig
config AIO_HOTPLUG
	bool "All in One HotPlug"
	depends on SMP && HOTPLUG_CPU
	default n
	help
	  an All in One HotPlug for Traditional Quad-Core SoCs and 
	  Hexa/Octa-Core big.LITTLE SoCs.
```

## arch/arm64/hotplug/ALUCARD/Kconfig
```kconfig
config ALUCARD_HOTPLUG
	bool "Enable alucard-hotplug cpu hotplug driver"
        depends on HOTPLUG_CPU
	default n
	help
	  Generic Alucard-hotplug cpu hotplug driver for ARM SOCs
```

## arch/arm64/hotplug/AUTOSMPTS/Kconfig
```kconfig
config ASMPTS
    bool "Multi-core automatic hotplug support"
    depends on SMP && HOTPLUG_CPU
    default n
    help
      Automatically hotplugs the multiple cpu cores on and off
      based on cpu load and suspend state

# config ASMP2
#    bool "Multi-core automatic hotplug support"
#    depends on SMP && HOTPLUG_CPU
#    default n
#    help
#      Automatically hotplugs the multiple cpu cores on and off
#      based on cpu load and suspend state. v2

# config ASMP2C
#    bool "Multi-core automatic hotplug support"
#    depends on SMP && HOTPLUG_CPU
#    default n
#    help
#      Automatically hotplugs the multiple cpu cores on and off
#      based on cpu load and suspend state. v2 two clusters
```

## arch/arm64/hotplug/BLUPLUG/Kconfig
```kconfig
config BLU_HOTPLUG
	bool "Dynamic hotplug driver"
	depends on HOTPLUG_CPU
	default n
	help
	  The Dynamic hotplug driver automatically online/offline CPUs proportional to system load.

config BLU2_HOTPLUG
	bool "Dynamic hotplug driver"
	depends on HOTPLUG_CPU
	default n
	help
	  The Dynamic hotplug driver automatically online/offline CPUs proportional to system load. v2
	    
```

## arch/arm64/hotplug/CLUSTER/Kconfig
```kconfig
config CLUSTER_HOTPLUG
	bool "Enable cluster-hotplug cpu hotplug driver"
        depends on HOTPLUG_CPU
	default n
	help
	  Generic Cluster-hotplug cpu hotplug driver for ARM SOCs big.little
```

## arch/arm64/hotplug/FASTPLUG/Kconfig
```kconfig
config FAST_HOTPLUG
	bool "Enable fast hotplug"
	default n
	help
	  Kernel based core control.
	  
```

## arch/arm64/hotplug/INTELLIPLUG/Kconfig
```kconfig
config INTELLI_HOTPLUG
	   bool "Enable intelli-plug cpu hotplug driver"
	   default n
	   help
		 Generic Intelli-plug cpu hotplug driver for ARM SOCs
```

## arch/arm64/hotplug/KTAUTO/Kconfig
```kconfig
config ARM_AUTO_HOTPLUG
	bool "Auto hotplugging based on scheduler runqueue load for ARM SoCs"
	default n
```

## arch/arm64/hotplug/LAZYPLUG/Kconfig
```kconfig
config LAZYPLUG
	bool "Conservative hotplugging for generic devices"
	default n
	help
	  This enables the conservative hotplugging, lazyplug by arter97
	  based on intelli_plug. Refer to the comments for more info.
```

## arch/arm64/hotplug/MAKO/Kconfig
```kconfig
config MAKO_HOTPLUG
    bool "Mako Hotplug"
    default n
    help
      Mako Hotplug: A custom hotplug by fransico franco
```

## arch/arm64/hotplug/MSMSLEEPER/Kconfig
```kconfig
config MSM_SLEEPER
    bool "CPU hotplug driver"
 	default y
 	help
	  CPU hotplug driver
```
